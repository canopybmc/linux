## Documentation/devicetree/bindings/hwmon/hpe,gxp-coretemp.yaml
```yaml
# SPDX-License-Identifier: (GPL-2.0-only OR BSD-2-Clause)
%YAML 1.2
---
$id: http://devicetree.org/schemas/hwmon/hpe,gxp-coretemp.yaml#
$schema: http://devicetree.org/meta-schemas/core.yaml#

title: HPE GXP SoC Core Temperature Sensor

maintainers:
  - Marcello Sylvester Bauer <marcello.bauer@9elements.com>

description: |
  The HPE GXP SoC includes an internal temperature sensor that measures the
  die temperature of the BMC processor.

properties:
  compatible:
    const: hpe,gxp-coretemp

  reg:
    maxItems: 1
    description: Temperature sensor registers

required:
  - compatible
  - reg

additionalProperties: false

examples:
  - |
    coretemp@c0000130 {
      compatible = "hpe,gxp-coretemp";
      reg = <0xc0000130 0x8>;
    };
```

## Documentation/devicetree/bindings/hwmon/hpe,gxp-fan-ctrl.yaml
```yaml
# SPDX-License-Identifier: (GPL-2.0-only OR BSD-2-Clause)
%YAML 1.2
---
$id: http://devicetree.org/schemas/hwmon/hpe,gxp-fan-ctrl.yaml#
$schema: http://devicetree.org/meta-schemas/core.yaml#

title: HPE GXP Fan Controller

maintainers:
  - Marcello Sylvester Bauer <marcello.bauer@9elements.com>

description: |
  The HPE GXP fan controller controls fans through an external CPLD.
  Fan presence and fault status are read from the XREG syscon. When
  a fan-supply regulator is provided, PWM reads return zero and writes
  are rejected while the supply is off (host powered down).

allOf:
  - $ref: fan-common.yaml#

properties:
  compatible:
    const: hpe,gxp-fan-ctrl

  reg:
    maxItems: 1
    description: Fan controller PWM registers

  hpe,xreg:
    $ref: /schemas/types.yaml#/definitions/phandle
    description: Phandle to the XREG syscon for fan install/fail status

  fan-supply:
    description: Phandle to host power supply regulator for power gating

required:
  - compatible
  - reg
  - hpe,xreg

unevaluatedProperties: false

examples:
  - |
    fan-controller@c1000c00 {
      compatible = "hpe,gxp-fan-ctrl";
      reg = <0xc1000c00 0x200>;
      hpe,xreg = <&xreg>;
      fan-supply = <&host_power>;
    };
```

## Documentation/devicetree/bindings/net/hpe,gxp-umac-mdio.yaml
```yaml
# SPDX-License-Identifier: (GPL-2.0-only OR BSD-2-Clause)
%YAML 1.2
---
$id: http://devicetree.org/schemas/net/hpe,gxp-umac-mdio.yaml#
$schema: http://devicetree.org/meta-schemas/core.yaml#

title: HPE GXP UMAC MDIO Bus

maintainers:
  - Marcello Sylvester Bauer <marcello.bauer@9elements.com>

description:
  MDIO bus controller for the HPE GXP UMAC ethernet MAC. Each UMAC
  has an associated MDIO bus for PHY management.

allOf:
  - $ref: mdio.yaml#

properties:
  compatible:
    const: hpe,gxp-umac-mdio

  reg:
    maxItems: 1

required:
  - compatible
  - reg

unevaluatedProperties: false

examples:
  - |
    mdio@c0004080 {
        compatible = "hpe,gxp-umac-mdio";
        reg = <0xc0004080 0x10>;
        #address-cells = <1>;
        #size-cells = <0>;

        ethernet-phy@0 {
            compatible = "ethernet-phy-ieee802.3-c22";
            phy-mode = "sgmii";
            reg = <0>;
        };
    };
```

## Documentation/devicetree/bindings/net/hpe,gxp-umac.yaml
```yaml
# SPDX-License-Identifier: (GPL-2.0-only OR BSD-2-Clause)
%YAML 1.2
---
$id: http://devicetree.org/schemas/net/hpe,gxp-umac.yaml#
$schema: http://devicetree.org/meta-schemas/core.yaml#

title: HPE GXP UMAC Ethernet Controller

maintainers:
  - Marcello Sylvester Bauer <marcello.bauer@9elements.com>

description:
  The HPE GXP SoC includes two UMAC ethernet controllers for BMC
  network connectivity. One is typically connected to an external
  Marvell PHY for dedicated management and the other uses NCSI
  for sideband communication with the host NIC.

allOf:
  - $ref: ethernet-controller.yaml#

properties:
  compatible:
    const: hpe,gxp-umac

  reg:
    maxItems: 1

  interrupts:
    maxItems: 1

  phy-handle:
    description: Reference to the external PHY

  int-phy-handle:
    $ref: /schemas/types.yaml#/definitions/phandle
    description: Reference to the internal PHY for SGMII/GMII bridging

  mac-address: true

  use-ncsi:
    type: boolean
    description: Use NCSI instead of standard PHY

required:
  - compatible
  - reg
  - interrupts

unevaluatedProperties: false

examples:
  - |
    ethernet@c0004000 {
        compatible = "hpe,gxp-umac";
        reg = <0xc0004000 0x80>;
        interrupts = <10>;
        phy-handle = <&ext_phy0>;
        int-phy-handle = <&int_phy0>;
        mac-address = [00 11 22 33 44 55];
    };
```

## Documentation/devicetree/bindings/nvmem/hpe,gxp-nvmem.yaml
```yaml
# SPDX-License-Identifier: (GPL-2.0-only OR BSD-2-Clause)
%YAML 1.2
---
$id: http://devicetree.org/schemas/nvmem/hpe,gxp-nvmem.yaml#
$schema: http://devicetree.org/meta-schemas/core.yaml#

title: HPE GXP Virtual EEPROM

maintainers:
  - Marcello Sylvester Bauer <marcello.bauer@9elements.com>

description: |
  Memory-mapped virtual EEPROM on HPE GXP BMC SoC containing board
  identification data including serial number, part number, and MAC addresses.

  The virtual EEPROM is located at physical address 0xa0017f00 and provides
  256 bytes of read-only board identification data programmed at manufacturing.

allOf:
  - $ref: nvmem.yaml#

properties:
  compatible:
    const: hpe,gxp-nvmem

  reg:
    maxItems: 1
    description: Physical address and size of the virtual EEPROM region

required:
  - compatible
  - reg

unevaluatedProperties: false

examples:
  - |
    veeprom: nvmem@a0017f00 {
        compatible = "hpe,gxp-nvmem";
        reg = <0xa0017f00 0x100>;
        read-only;

        nvmem-layout {
            compatible = "fixed-layout";
            #address-cells = <1>;
            #size-cells = <1>;

            serial-number@1 {
                reg = <0x01 0x10>;
            };

            part-number@6d {
                reg = <0x6d 0x10>;
            };

            mac-address-0@84 {
                reg = <0x84 0x06>;
            };

            mac-address-1@8a {
                reg = <0x8a 0x06>;
            };
        };
    };
```

## Documentation/devicetree/bindings/peci/hpe,gxp-peci.yaml
```yaml
# SPDX-License-Identifier: (GPL-2.0-only OR BSD-2-Clause)
%YAML 1.2
---
$id: http://devicetree.org/schemas/peci/hpe,gxp-peci.yaml#
$schema: http://devicetree.org/meta-schemas/core.yaml#

title: HPE GXP PECI Bus

maintainers:
  - Marcello Sylvester Bauer <marcello.bauer@9elements.com>

allOf:
  - $ref: peci-controller.yaml#

properties:
  compatible:
    const: hpe,gxp-peci

  reg:
    maxItems: 1

  interrupts:
    maxItems: 1

  peci-supply:
    description: Host power supply regulator for PECI bus power gating

required:
  - compatible
  - reg
  - interrupts

additionalProperties: false

examples:
  - |
    peci-controller@80000400 {
      compatible = "hpe,gxp-peci";
      reg = <0x80000400 0x200>;
      interrupts = <22>;
      interrupt-parent = <&vic1>;
      peci-supply = <&host_power>;
    };
```

## Documentation/devicetree/bindings/regulator/hpe,gxp-host-power-supply.yaml
```yaml
# SPDX-License-Identifier: (GPL-2.0-only OR BSD-2-Clause)
%YAML 1.2
---
$id: http://devicetree.org/schemas/regulator/hpe,gxp-host-power-supply.yaml#
$schema: http://devicetree.org/meta-schemas/core.yaml#

title: HPE GXP CPLD Host Power Supply

maintainers:
  - Marcello Sylvester Bauer <marcello.bauer@9elements.com>

description: |
  The HPE GXP SoC uses a CPLD that controls the host power rail.
  This regulator exposes the CPLD power-good state to consumer
  devices (fans, sensors) through the regulator framework. The
  enable state is read from the FN2 system event status register.

  This node must be a child of the FN2 syscon node.

allOf:
  - $ref: regulator.yaml#

properties:
  compatible:
    const: hpe,gxp-host-power-supply

  regulator-name: true

required:
  - compatible

unevaluatedProperties: false

examples:
  - |
    syscon@80200000 {
      compatible = "hpe,gxp-fn2", "simple-mfd", "syscon";
      reg = <0x80200000 0x100000>;

      regulator-host-power {
        compatible = "hpe,gxp-host-power-supply";
        regulator-name = "host-power";
      };
    };
```

## Documentation/devicetree/bindings/serial/hpe,gxp-vuart.yaml
```yaml
# SPDX-License-Identifier: (GPL-2.0-only OR BSD-2-Clause)
%YAML 1.2
---
$id: http://devicetree.org/schemas/serial/hpe,gxp-vuart.yaml#
$schema: http://devicetree.org/meta-schemas/core.yaml#

title: HPE GXP Virtual UART

maintainers:
  - Marcello Sylvester Bauer <marcello.bauer@9elements.com>

description:
  The HPE GXP BMC SoC provides a Virtual UART (VUART) that connects the
  BMC to the host CPU over an internal LPC bus path. The VUART appears as
  a 16550A-compatible device with additional GXP-specific control and
  status registers for FIFO management and host-side interrupt routing.

properties:
  compatible:
    const: hpe,gxp-vuart

  reg:
    maxItems: 1

  interrupts:
    maxItems: 1

  clock-frequency:
    description:
      UART input clock frequency in Hz.

  reg-shift:
    description:
      Quantity to shift the register offsets by.

  serial-line:
    $ref: /schemas/types.yaml#/definitions/uint32
    description:
      Force a specific ttyS line number for this UART.

  vuart-cfg:
    $ref: /schemas/types.yaml#/definitions/phandle
    description:
      Phandle to a syscon node providing the VUART host-side configuration
      registers (LPC address and SIRQ routing).

required:
  - compatible
  - reg
  - interrupts
  - clock-frequency
  - vuart-cfg

additionalProperties: false

examples:
  - |
    vuart_cfg: syscon@80fc0230 {
        compatible = "hpe,gxp-vuart-cfg", "syscon";
        reg = <0x80fc0230 0x100>;
        reg-io-width = <1>;
    };

    serial@80fd0200 {
        compatible = "hpe,gxp-vuart";
        reg = <0x80fd0200 0x100>;
        interrupts = <2>;
        clock-frequency = <1846153>;
        reg-shift = <0>;
        serial-line = <3>;
        vuart-cfg = <&vuart_cfg>;
    };
```

## Documentation/devicetree/bindings/soc/hpe/hpe,gxp-chif.yaml
```yaml
# SPDX-License-Identifier: (GPL-2.0-only OR BSD-2-Clause)
%YAML 1.2
---
$id: http://devicetree.org/schemas/soc/hpe/hpe,gxp-chif.yaml#
$schema: http://devicetree.org/meta-schemas/core.yaml#

title: HPE GXP CHIF (Channel Interface)

maintainers:
  - Marcello Sylvester Bauer <marcello.bauer@9elements.com>

description: |
  The HPE GXP SoC includes a Channel Interface (CHIF) block that provides
  bidirectional communication between the BMC and host CPU. The driver
  exposes a character device (/dev/chif24) for userspace applications to
  exchange packets with the host.

  Features:
  - 1MB DMA-coherent shared memory with 32-channel CCB table
  - Doorbell interrupt handling for packet notifications
  - Read/write interface for packet exchange
  - Sysfs interface for protocol header inspection

  This node must be a child of the FN2 syscon node.

properties:
  compatible:
    const: hpe,gxp-chif

  interrupts:
    maxItems: 1
    description: Doorbell interrupt from host

required:
  - compatible
  - interrupts

additionalProperties: false

examples:
  - |
    fn2: fn2@80200000 {
        compatible = "hpe,gxp-fn2", "simple-mfd", "syscon";
        reg = <0x80200000 0x100000>;
        #address-cells = <1>;
        #size-cells = <1>;

        chif {
            compatible = "hpe,gxp-chif";
            interrupts = <12>;
        };
    };
```

## Documentation/devicetree/bindings/soc/hpe/hpe,gxp-csm.yaml
```yaml
# SPDX-License-Identifier: (GPL-2.0-only OR BSD-2-Clause)
%YAML 1.2
---
$id: http://devicetree.org/schemas/soc/hpe/hpe,gxp-csm.yaml#
$schema: http://devicetree.org/meta-schemas/core.yaml#

title: HPE GXP CSM (Slave Instrumentation and System Support)

maintainers:
  - Marcello Sylvester Bauer <marcello.bauer@9elements.com>

description:
  The HPE GXP SoC includes a CSM (Slave Instrumentation and System Support)
  block that provides system control registers and GPIO functionality. This
  driver exposes sysfs interfaces for controlling virtual EHCI enable and
  software shutdown.

properties:
  compatible:
    items:
      - const: hpe,gxp-csm
      - const: simple-mfd
      - const: syscon

  reg:
    maxItems: 1

required:
  - compatible
  - reg

additionalProperties: false

examples:
  - |
    csm: csm@80000000 {
        compatible = "hpe,gxp-csm", "simple-mfd", "syscon";
        reg = <0x80000000 0x400>;
    };
```

## Documentation/devicetree/bindings/soc/hpe/hpe,gxp-fn2.yaml
```yaml
# SPDX-License-Identifier: (GPL-2.0-only OR BSD-2-Clause)
%YAML 1.2
---
$id: http://devicetree.org/schemas/soc/hpe/hpe,gxp-fn2.yaml#
$schema: http://devicetree.org/meta-schemas/core.yaml#

title: HPE GXP FN2 (Embedded Management Processor Support and Configuration)

maintainers:
  - Marcello Sylvester Bauer <marcello.bauer@9elements.com>

description: |
  The HPE GXP SoC includes a FN2 (Function 2) block that provides:
  - GPIO lines for power state control (VPBTN, PGOOD, PERST)
  - System event register for PGOOD/PERST interrupt handling
  - Virtual power button control

properties:
  compatible:
    items:
      - const: hpe,gxp-fn2
      - const: simple-mfd
      - const: syscon

  reg:
    maxItems: 1
    description: Memory region for FN2 registers

  interrupts:
    maxItems: 1
    description: FN2 system event interrupt for PGOOD/PERST

  interrupt-controller: true

  "#interrupt-cells":
    const: 2

  gpio-controller: true

  "#gpio-cells":
    const: 2

  gpio-line-names:
    minItems: 1
    maxItems: 50

  chif:
    type: object
    $ref: hpe,gxp-chif.yaml#

required:
  - compatible
  - reg
  - interrupts
  - gpio-controller
  - "#gpio-cells"

additionalProperties: false

examples:
  - |
    fn2: fn2@80200000 {
        compatible = "hpe,gxp-fn2", "simple-mfd", "syscon";
        reg = <0x80200000 0x100000>;
        interrupts = <0>;
        interrupt-parent = <&vic1>;
        interrupt-controller;
        #interrupt-cells = <2>;
        gpio-controller;
        #gpio-cells = <2>;

        gpio-line-names =
            "vpbtn",        /* Virtual power button (output) */
            "pgood",        /* Power good (input) */
            "perst",        /* PCIe reset (input) */
            "post-complete", /* POST complete (input) */
            "btn-state";    /* Button state (input) */
    };
```

## Documentation/devicetree/bindings/soc/hpe/hpe,gxp-xreg.yaml
```yaml
# SPDX-License-Identifier: (GPL-2.0-only OR BSD-2-Clause)
%YAML 1.2
---
$id: http://devicetree.org/schemas/soc/hpe/hpe,gxp-xreg.yaml#
$schema: http://devicetree.org/meta-schemas/core.yaml#

title: HPE GXP XREG (Extended Register Block)

maintainers:
  - Marcello Sylvester Bauer <marcello.bauer@9elements.com>

description: |
  The HPE GXP SoC includes an extended register block (XREG) that provides:
  - 150 GPIO lines for LEDs, fan status, PSU presence, and buttons
  - Two interrupt groups (GRP5/GRP6) for edge-triggered events
  - Server identification registers
  - Sideband selection control

properties:
  compatible:
    items:
      - const: hpe,gxp-xreg
      - const: simple-mfd
      - const: syscon

  reg:
    maxItems: 1

  interrupts:
    maxItems: 1
    description: XREG interrupt for GPIO events (GRP5/GRP6)

  interrupt-controller: true

  "#interrupt-cells":
    const: 2

  gpio-controller: true

  "#gpio-cells":
    const: 2

  gpio-line-names:
    minItems: 1
    maxItems: 150

required:
  - compatible
  - reg
  - interrupts
  - gpio-controller
  - "#gpio-cells"

additionalProperties: false

examples:
  - |
    xreg: xreg@d1000000 {
        compatible = "hpe,gxp-xreg", "simple-mfd", "syscon";
        reg = <0xd1000000 0x11c>;
        interrupts = <26>;
        interrupt-parent = <&vic0>;
        interrupt-controller;
        #interrupt-cells = <2>;
        gpio-controller;
        #gpio-cells = <2>;
    };
```

## arch/arm/mach-hpe/Kconfig
```kconfig
menuconfig ARCH_HPE
	bool "HPE SoC support"
	help
	  This enables support for HPE ARM based SoC chips
if ARCH_HPE

config ARCH_HPE_GXP
	bool "HPE GXP SoC"
	select ARM_VIC
	select PINCTRL
	select IRQ_DOMAIN
	select GENERIC_IRQ_CHIP
	select MULTI_IRQ_HANDLER
	select SPARSE_IRQ
	select CLKSRC_MMIO
	depends on ARCH_MULTI_V7
	help
	  Support for GXP SoCs

config ARCH_HPE_GXP_GEN10
	bool "HPE GXP SoC generation 10"
	depends on ARCH_HPE_GXP
	help
	  Support for GXP SoCs of 10th generation

config ARCH_HPE_GXP_GEN11
	bool "HPE GXP SoC generation 11"
	depends on ARCH_HPE_GXP
	help
	  Support for GXP SoCs of 11th generation

endif
```

## drivers/net/ethernet/hpe/Kconfig
```kconfig
# SPDX-License-Identifier: GPL-2.0-only
#
# HPE network device configuration
#

config NET_VENDOR_HPE
       bool "Hewlett Packard Enterprise devices"
       default y
       depends on ARCH_HPE || COMPILE_TEST
       help
         If you have a network (Ethernet) card belonging to this class, say Y.

         Note that the answer to this question doesn't directly affect the
         kernel: saying N will just cause the configurator to skip all
         the questions about HPE devices. If you say Y, you will be asked
         for your specific card in the following questions.

if NET_VENDOR_HPE

config GXP_UMAC
       tristate "HPE GXP UMAC support"
       depends on ARCH_HPE || COMPILE_TEST
	   depends on OF_MDIO && HAS_IOMEM
       select MDIO_GXP_UMAC
	   select MARVELL_PHY
       help
         This driver supports the UMAC ethernet controller found on
         HPE GXP BMC SoCs. The GXP is used in HPE ProLiant Gen10/Gen11
         servers. Say Y here if you want to use the ethernet interface
         on these systems.

         To compile this driver as a module, choose M here. The module
         will be called gxp-umac.

endif # NET_VENDOR_HPE
```

## drivers/soc/hpe/Kconfig
```kconfig
# SPDX-License-Identifier: GPL-2.0-only
#
# HPE SoC drivers
#

config SOC_HPE
	bool "HPE SoC drivers"
	depends on ARCH_HPE || COMPILE_TEST
	help
	  Say Y here to enable support for HPE GXP SoC drivers.
	  The GXP is a BMC SoC used in HPE ProLiant servers. This
	  option enables the SoC infrastructure drivers for CSM,
	  XREG, and FN2 register blocks.

if SOC_HPE

config SOC_HPE_GXP
	bool
	default n

config SOC_HPE_GXP_CSM
	tristate "HPE GXP CSM support"
	depends on ARCH_HPE_GXP || COMPILE_TEST
	select SOC_HPE_GXP
	select MFD_SYSCON
	select REGMAP_MMIO
	help
	  Say Y here to add support for the HPE GXP CSM (Slave
	  Instrumentation and System Support) block. This provides
	  sysfs interfaces for controlling virtual EHCI enable and
	  software shutdown.

config SOC_HPE_GXP_XREG
	tristate "HPE GXP XREG support"
	depends on ARCH_HPE_GXP || COMPILE_TEST
	depends on GPIOLIB
	select SOC_HPE_GXP
	select MFD_SYSCON
	select REGMAP_MMIO
	select GPIOLIB_IRQCHIP
	help
	  Say Y here to add support for the HPE GXP XREG (Extended
	  Register Block). This provides 150 GPIO lines for LEDs,
	  fan status, PSU presence, and buttons with interrupt
	  support for power button and PSU events.

config SOC_HPE_GXP_FN2
	tristate "HPE GXP FN2 support"
	depends on ARCH_HPE_GXP || COMPILE_TEST
	depends on GPIOLIB
	select SOC_HPE_GXP
	select MFD_SYSCON
	select REGMAP_MMIO
	select GPIOLIB_IRQCHIP
	help
	  Say Y here to add support for the HPE GXP FN2 (Embedded
	  Management Processor Support and Configuration). This
	  provides GPIO lines for power state control (VPBTN,
	  PGOOD, PERST) and interrupt handling.

config SOC_HPE_GXP_POWER_CTRL
	tristate "HPE GXP host power controller"
	depends on ARCH_HPE_GXP || COMPILE_TEST
	depends on GPIOLIB
	depends on SOC_HPE_GXP_FN2
	depends on SOC_HPE_GXP_XREG
	select MFD_SYSCON
	select REGMAP_MMIO
	help
	  Say Y here to add support for the HPE GXP host power
	  controller. This wraps the FN2 virtual power button and
	  power good GPIO lines, injecting CPLD register
	  configuration during host power state transitions.
	  It exposes two GPIO lines (power-button and power-good)
	  for integration with x86-power-control.

config SOC_HPE_GXP_CHIF
	tristate "HPE GXP CHIF support"
	depends on ARCH_HPE_GXP || COMPILE_TEST
	select SOC_HPE_GXP
	select MFD_SYSCON
	select REGMAP_MMIO
	help
	  Say Y here to add support for the HPE GXP CHIF (Channel
	  Interface) block. This provides character device access
	  (/dev/chif24) for bidirectional host-BMC communication
	  via 1MB DMA-coherent shared memory.

endif # SOC_HPE
```

## drivers/ubm/Kconfig
```kconfig
# SPDX-License-Identifier: GPL-2.0-only
#
# Hardware monitoring chip drivers configuration
#

menuconfig UBM
	tristate "Universal Sotrage Backplane Management support"
	depends on HAS_IOMEM
	default y
	help
		Enable UBM support

config UBM4
        tristate "UBM 4 driver"
	default n
        help
          If you say yes here you get support for ubm 4 function
```
